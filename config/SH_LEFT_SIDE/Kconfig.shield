## config/boards/shields/left_side/Kconfig.defconfig
```kconfig
if SHIELD_LEFT_SIDE

config ZMK_KEYBOARD_NAME
    default "left_side"

CONFIG_EC11=y

CONFIG_EC11_TRIGGER_GLOBAL_THREAD=y

endif
```

## config/left_side/Kconfig.defconfig
```kconfig
if SH_LEFT_SIDE

config ZMK_KEYBOARD_NAME
    default "Split keeb left side"

config CONFIG_ZMK_HID_REPORT_TYPE_HKRO
    defualt y

config CONFIG_USB_DEVICE_MANUFACTURER
    default "CB design's"

endif
```
